## app/dts/bindings/behaviors/zmk,behavior-battery-status.yaml
```yaml
# Copyright (c) 2021 The ZMK Contributors
# SPDX-License-Identifier: MIT

description: Battery Status behavior

compatible: "zmk,behavior-battery-status"

include: zero_param.yaml
```
